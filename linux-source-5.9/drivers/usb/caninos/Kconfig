## linux-source-5.9/drivers/usb/caninos/Kconfig
```kconfig
config USB_CANINOS
	tristate "Caninos USB2.0 OTG support"
	default y
	help
	  The Caninos chips have USB2.0 otg controllers. Enable
	  this option if your board uses this chip. If unsure, say N.

	  To compile this driver as a module, choose M here: the
	  module will be called aotg.

config USB_CANINOS_HCD
	tristate "Caninos USB2.0 HCD support"
	depends on USB_CANINOS
	default y
	help
	  The Actions USB2.0 otg controllers have USB2.0 host controllers. Enable
	  this option if your board uses this chip. If unsure, say N.
```
